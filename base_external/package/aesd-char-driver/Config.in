## base_external/package/aesd-char-driver/Config.in
```kconfig
config BR2_PACKAGE_AESD_CHAR_DRIVER
	bool "aesd-char-driver"
	help
	  Supports building and installing the AESD character driver
	  components into the root filesystem in the kernel image.
```
